## CMakeLists.txt
```
# SPDX-License-Identifier: Apache-2.0
cmake_minimum_required(VERSION 3.20.0)

find_package(Zephyr REQUIRED HINTS $ENV{ZEPHYR_BASE})
project(sensor_node)

# Every .c file in src/ is part of the app. CONFIGURE_DEPENDS re-globs on each
# build, so a new file is picked up without a pristine build.
file(GLOB app_sources CONFIGURE_DEPENDS src/*.c)
target_sources(app PRIVATE ${app_sources})
```

## Kconfig
```
# The app's own Kconfig options. Zephyr picks this file up automatically
# because it sits next to CMakeLists.txt.

menu "Sensor node"

# Your options go here (milestone 1).

endmenu

# Everything else in Zephyr. Keep this line last.
source "Kconfig.zephyr"
```

## prj.conf
```kconfig
# Kconfig for the app. These are requests, not orders: check the build log
# for "was assigned the value y but got the value n".
CONFIG_LOG=y
```

## app.overlay
```dts
/*
 * Devicetree overlay for this app. With no boards/<board>.overlay present,
 * Zephyr uses app.overlay for every board, including native_sim and
 * native_sim/native/64. Your sensor node goes here (milestone 2).
 */

/ {
};
```

## dts/bindings/vnd,ramp-temp.yaml
```yaml
description: |
  A pretend temperature sensor for native_sim. Every sample fetch produces the
  next value of a repeating ramp: start, start + step, start + 2 * step, ...
  for ramp-steps values, and then it starts over at start.

  Example: start 20000, step 500 and 4 ramp steps give
  20.000, 20.500, 21.000, 21.500, 20.000, 20.500, ... degrees Celsius.

compatible: "vnd,ramp-temp"

include: base.yaml

properties:
  start-millicelsius:
    type: int
    required: true
    description: First value of the ramp, in millidegrees Celsius.

  step-millicelsius:
    type: int
    required: true
    description: How much each sample adds to the previous one, in millidegrees Celsius.

  ramp-steps:
    type: int
    required: true
    description: How many values the ramp has before it starts over. Must be at least 1.
```

## src/main.c
```c
/*
 * The entry point. Keep main.c to main() only: the tests build every other
 * file in src/ into their own image (which has its own main), so anything
 * the node does must start without main's help.
 */
#include <zephyr/kernel.h>
#include <zephyr/logging/log.h>

LOG_MODULE_REGISTER(sensor_node, LOG_LEVEL_INF);

int main(void)
{
	LOG_INF("sensor node starting on %s", CONFIG_BOARD);
	return 0;
}
```

## src/ramp_temp.c
```c
/*
 * Driver for "vnd,ramp-temp" (milestone 2). The plumbing is here: the
 * compatible, the per-instance config filled from the devicetree, the API
 * struct and the macro that creates one device per enabled node. What the
 * sensor actually does is yours: fill in the TODOs.
 *
 * Until then every fetch and get fails with -ENOSYS, so the m2 tests fail.
 *
 * Until app.overlay has a vnd,ramp-temp node, the macro at the bottom
 * creates no device, and gcc warns that ramp_temp_init is unused. That's
 * expected: the warning goes away when you add the node in milestone 2.
 */
#define DT_DRV_COMPAT vnd_ramp_temp

#include <errno.h>

#include <zephyr/device.h>
#include <zephyr/drivers/sensor.h>
#include <zephyr/kernel.h>

/* Read-only, one per instance, straight from the node's properties. */
struct ramp_temp_config {
	int32_t start_mc;
	int32_t step_mc;
	int32_t steps;
};

/* Mutable, one per instance. */
struct ramp_temp_data {
	/* TODO: where is this instance on its ramp, and what was its last sample? */
};

static int ramp_temp_sample_fetch(const struct device *dev, enum sensor_channel chan)
{
	/* TODO: check the channel, take the next value of the ramp, advance and wrap. */
	ARG_UNUSED(dev);
	ARG_UNUSED(chan);
	return -ENOSYS;
}

static int ramp_temp_channel_get(const struct device *dev, enum sensor_channel chan, struct sensor_value *val)
{
	/* TODO: check the channel, turn the last sample into a struct sensor_value. */
	ARG_UNUSED(dev);
	ARG_UNUSED(chan);
	ARG_UNUSED(val);
	return -ENOSYS;
}

static int ramp_temp_init(const struct device *dev)
{
	/* TODO: return an error for a ramp that can't work, so device_is_ready() is false. */
	ARG_UNUSED(dev);
	return 0;
}

static DEVICE_API(sensor, ramp_temp_api) = {
	.sample_fetch = ramp_temp_sample_fetch,
	.channel_get = ramp_temp_channel_get,
};

/* Runs once per enabled vnd,ramp-temp node; inst is 0, 1, 2, ... */
#define RAMP_TEMP_DEFINE(inst)                                                                                 \
	static struct ramp_temp_data ramp_temp_data_##inst;                                                    \
	static const struct ramp_temp_config ramp_temp_config_##inst = {                                       \
		.start_mc = DT_INST_PROP(inst, start_millicelsius),                                            \
		.step_mc = DT_INST_PROP(inst, step_millicelsius),                                              \
		.steps = DT_INST_PROP(inst, ramp_steps),                                                       \
	};                                                                                                     \
	DEVICE_DT_INST_DEFINE(inst, ramp_temp_init, NULL, &ramp_temp_data_##inst, &ramp_temp_config_##inst,   \
			      POST_KERNEL, CONFIG_SENSOR_INIT_PRIORITY, &ramp_temp_api);

DT_INST_FOREACH_STATUS_OKAY(RAMP_TEMP_DEFINE)
```
