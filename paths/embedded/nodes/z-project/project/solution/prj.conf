## Kconfig
```
# The app's own Kconfig options. Zephyr picks this file up automatically
# because it sits next to CMakeLists.txt.

menu "Sensor node"

config SENSOR_NODE_SAMPLE_MS
	int "Sampling period (ms)"
	range 10 10000
	default 100
	help
	  How often the sampler thread reads the ambient sensor.

config SENSOR_NODE_REPORT_MS
	int "Initial report period (ms)"
	range 10 60000
	default 1000
	help
	  How often a report is logged. "node period" changes it at runtime.

config SENSOR_NODE_QUEUE_LEN
	int "Sample queue length"
	range 1 64
	default 8
	help
	  How many samples can wait between the sampler and the processing
	  thread before new ones are dropped.

endmenu

# Everything else in Zephyr. Keep this line last.
source "Kconfig.zephyr"
```

## prj.conf
```kconfig
# Kconfig for the app. These are requests, not orders: check the build log
# for "was assigned the value y but got the value n".
CONFIG_LOG=y
CONFIG_SENSOR=y
CONFIG_SHELL=y
```

## app.overlay
```dts
/*
 * Devicetree overlay for this app. With no boards/<board>.overlay present,
 * Zephyr uses app.overlay for every board, including native_sim and
 * native_sim/native/64.
 */

/ {
	aliases {
		ambient-temp = &ambient;
	};

	/* 21.000, 21.250, ... 22.750, then again */
	ambient: ambient-sensor {
		compatible = "vnd,ramp-temp";
		start-millicelsius = <21000>;
		step-millicelsius = <250>;
		ramp-steps = <8>;
	};
};
```

## src/main.c
```c
/*
 * The entry point. Keep main.c to main() only: the tests build every other
 * file in src/ into their own image (which has its own main), so anything
 * the node does must start without main's help.
 */
#include <zephyr/kernel.h>
#include <zephyr/logging/log.h>

LOG_MODULE_REGISTER(sensor_node, LOG_LEVEL_INF);

int main(void)
{
	LOG_INF("sensor node starting on %s", CONFIG_BOARD);
	LOG_INF("sampling every %d ms, reporting every %d ms", CONFIG_SENSOR_NODE_SAMPLE_MS,
		CONFIG_SENSOR_NODE_REPORT_MS);
	return 0;
}
```

## src/ramp_temp.c
```c
/*
 * Driver for "vnd,ramp-temp": a pretend temperature sensor whose samples
 * walk up a ramp and start over. One instance per enabled devicetree node.
 */
#define DT_DRV_COMPAT vnd_ramp_temp

#include <errno.h>

#include <zephyr/device.h>
#include <zephyr/drivers/sensor.h>
#include <zephyr/kernel.h>
#include <zephyr/spinlock.h>

struct ramp_temp_config {
	int32_t start_mc;
	int32_t step_mc;
	int32_t steps;
};

struct ramp_temp_data {
	struct k_spinlock lock;
	int32_t index;
	int32_t sample_mc;
	bool has_sample;
};

static int ramp_temp_sample_fetch(const struct device *dev, enum sensor_channel chan)
{
	const struct ramp_temp_config *cfg = dev->config;
	struct ramp_temp_data *data = dev->data;

	if (chan != SENSOR_CHAN_ALL && chan != SENSOR_CHAN_AMBIENT_TEMP) {
		return -ENOTSUP;
	}

	k_spinlock_key_t key = k_spin_lock(&data->lock);

	data->sample_mc = cfg->start_mc + data->index * cfg->step_mc;
	data->index = (data->index + 1) % cfg->steps;
	data->has_sample = true;
	k_spin_unlock(&data->lock, key);
	return 0;
}

static int ramp_temp_channel_get(const struct device *dev, enum sensor_channel chan, struct sensor_value *val)
{
	struct ramp_temp_data *data = dev->data;

	if (chan != SENSOR_CHAN_AMBIENT_TEMP) {
		return -ENOTSUP;
	}

	k_spinlock_key_t key = k_spin_lock(&data->lock);
	int32_t mc = data->sample_mc;
	bool has_sample = data->has_sample;

	k_spin_unlock(&data->lock, key);
	if (!has_sample) {
		return -ENODATA;
	}

	/* sensor_value is whole units plus millionths, both with the same sign. */
	val->val1 = mc / 1000;
	val->val2 = (mc % 1000) * 1000;
	return 0;
}

static int ramp_temp_init(const struct device *dev)
{
	const struct ramp_temp_config *cfg = dev->config;

	/* A failed init makes device_is_ready() false instead of dividing by zero later. */
	return cfg->steps >= 1 ? 0 : -EINVAL;
}

static DEVICE_API(sensor, ramp_temp_api) = {
	.sample_fetch = ramp_temp_sample_fetch,
	.channel_get = ramp_temp_channel_get,
};

#define RAMP_TEMP_DEFINE(inst)                                                                                 \
	static struct ramp_temp_data ramp_temp_data_##inst;                                                    \
	static const struct ramp_temp_config ramp_temp_config_##inst = {                                       \
		.start_mc = DT_INST_PROP(inst, start_millicelsius),                                            \
		.step_mc = DT_INST_PROP(inst, step_millicelsius),                                              \
		.steps = DT_INST_PROP(inst, ramp_steps),                                                       \
	};                                                                                                     \
	DEVICE_DT_INST_DEFINE(inst, ramp_temp_init, NULL, &ramp_temp_data_##inst, &ramp_temp_config_##inst,   \
			      POST_KERNEL, CONFIG_SENSOR_INIT_PRIORITY, &ramp_temp_api);

DT_INST_FOREACH_STATUS_OKAY(RAMP_TEMP_DEFINE)
```

## src/reporter.c
```c
/*
 * report_timer (ISR context) --k_work_submit--> report_work (system workqueue)
 *
 * The expiry runs inside the timer interrupt, so it only submits the work.
 * Taking the stats mutex and logging happen in the work handler, in a thread.
 */
#include <errno.h>

#include <zephyr/init.h>
#include <zephyr/kernel.h>
#include <zephyr/logging/log.h>

#include "reporter.h"
#include "stats.h"

LOG_MODULE_REGISTER(reporter, LOG_LEVEL_INF);

static void report_handler(struct k_work *work)
{
	struct stats s;
	char min[16], max[16], mean[16];

	ARG_UNUSED(work);

	stats_count_report();
	stats_get(&s);
	if (s.samples == 0) {
		LOG_INF("report: no samples yet");
		return;
	}

	format_milli(min, sizeof(min), s.min_mc);
	format_milli(max, sizeof(max), s.max_mc);
	format_milli(mean, sizeof(mean), s.sum_mc / s.samples);
	LOG_INF("report: %u samples, min %s, max %s, mean %s C, %u dropped", (unsigned int)s.samples, min, max, mean,
		(unsigned int)s.dropped);
}

K_WORK_DEFINE(report_work, report_handler);

static void report_expiry(struct k_timer *timer)
{
	ARG_UNUSED(timer);
	k_work_submit(&report_work);
}

K_TIMER_DEFINE(report_timer, report_expiry, NULL);

int reporter_set_period(uint32_t period_ms)
{
	if (period_ms < REPORTER_MIN_MS || period_ms > REPORTER_MAX_MS) {
		return -EINVAL;
	}
	/* Periodic from the start: restarting a one-shot from the handler would drift. */
	k_timer_start(&report_timer, K_MSEC(period_ms), K_MSEC(period_ms));
	return 0;
}

static int reporter_init(void)
{
	return reporter_set_period(CONFIG_SENSOR_NODE_REPORT_MS);
}

SYS_INIT(reporter_init, APPLICATION, CONFIG_APPLICATION_INIT_PRIORITY);
```

## src/reporter.h
```c
#ifndef REPORTER_H
#define REPORTER_H

#include <stdint.h>

#define REPORTER_MIN_MS 10
#define REPORTER_MAX_MS 60000

/* Restarts the report timer with a new period. -EINVAL if it's out of range. */
int reporter_set_period(uint32_t period_ms);

#endif /* REPORTER_H */
```

## src/sampler.c
```c
/*
 * sampler (every SENSOR_NODE_SAMPLE_MS) --k_msgq--> processing --> stats
 *
 * The sampler never waits for the queue: if processing falls behind, the
 * sample is dropped and counted, and the sampling period stays steady.
 */
#include <errno.h>

#include <zephyr/device.h>
#include <zephyr/devicetree.h>
#include <zephyr/drivers/sensor.h>
#include <zephyr/kernel.h>
#include <zephyr/logging/log.h>

#include "sampler.h"
#include "stats.h"

LOG_MODULE_REGISTER(sampler, LOG_LEVEL_INF);

struct sample {
	int32_t milli_c;
	uint32_t taken_ms;
};

K_MSGQ_DEFINE(sample_q, sizeof(struct sample), CONFIG_SENSOR_NODE_QUEUE_LEN, 4);

/* The sampler and the shell both read the sensor; fetch + get must be one step. */
K_MUTEX_DEFINE(sensor_lock);

static const struct device *const ambient = DEVICE_DT_GET(DT_ALIAS(ambient_temp));

int sampler_read(int32_t *milli_c)
{
	struct sensor_value val;
	int err;

	if (!device_is_ready(ambient)) {
		return -ENODEV;
	}

	k_mutex_lock(&sensor_lock, K_FOREVER);
	err = sensor_sample_fetch(ambient);
	if (err == 0) {
		err = sensor_channel_get(ambient, SENSOR_CHAN_AMBIENT_TEMP, &val);
	}
	k_mutex_unlock(&sensor_lock);

	if (err == 0) {
		*milli_c = val.val1 * 1000 + val.val2 / 1000;
	}
	return err;
}

static void sampler_thread(void *p1, void *p2, void *p3)
{
	ARG_UNUSED(p1);
	ARG_UNUSED(p2);
	ARG_UNUSED(p3);

	if (!device_is_ready(ambient)) {
		LOG_ERR("%s is not ready, not sampling", ambient->name);
		return;
	}

	/* Absolute deadlines: a late wake-up doesn't push every later sample back. */
	int64_t next = k_uptime_get();

	for (;;) {
		struct sample s = {.taken_ms = k_uptime_get_32()};
		int err = sampler_read(&s.milli_c);

		if (err != 0) {
			LOG_WRN("reading %s failed: %d", ambient->name, err);
		} else if (k_msgq_put(&sample_q, &s, K_NO_WAIT) != 0) {
			stats_count_drop();
		}

		next += CONFIG_SENSOR_NODE_SAMPLE_MS;
		k_sleep(K_TIMEOUT_ABS_MS(next));
	}
}

static void processing_thread(void *p1, void *p2, void *p3)
{
	struct sample s;

	ARG_UNUSED(p1);
	ARG_UNUSED(p2);
	ARG_UNUSED(p3);

	for (;;) {
		k_msgq_get(&sample_q, &s, K_FOREVER);
		stats_add(s.milli_c);
		LOG_DBG("sample %d mC, %u ms in the queue", s.milli_c, k_uptime_get_32() - s.taken_ms);
	}
}

/* Both preemptible. Processing is more urgent (lower number), so the queue drains first. */
K_THREAD_DEFINE(sampler_tid, 1024, sampler_thread, NULL, NULL, NULL, 6, 0, 0);
K_THREAD_DEFINE(processing_tid, 1024, processing_thread, NULL, NULL, NULL, 5, 0, 0);
```

## src/sampler.h
```c
#ifndef SAMPLER_H
#define SAMPLER_H

#include <stdint.h>

/* Takes one reading from the ambient sensor now. 0 on success, or a negative errno. */
int sampler_read(int32_t *milli_c);

#endif /* SAMPLER_H */
```

## src/shell_cmds.c
```c
/* The "node" shell command: node stats | reset | read | period <ms>. */
#include <errno.h>
#include <stdlib.h>

#include <zephyr/kernel.h>
#include <zephyr/shell/shell.h>

#include "reporter.h"
#include "sampler.h"
#include "stats.h"

static int cmd_stats(const struct shell *sh, size_t argc, char **argv)
{
	struct stats s;
	char min[16] = "n/a", max[16] = "n/a", mean[16] = "n/a";

	ARG_UNUSED(argc);
	ARG_UNUSED(argv);

	stats_get(&s);
	if (s.samples > 0) {
		format_milli(min, sizeof(min), s.min_mc);
		format_milli(max, sizeof(max), s.max_mc);
		format_milli(mean, sizeof(mean), s.sum_mc / s.samples);
	}
	shell_print(sh, "samples=%u min=%s max=%s mean=%s dropped=%u reports=%u", (unsigned int)s.samples, min, max,
		    mean, (unsigned int)s.dropped, (unsigned int)s.reports);
	return 0;
}

static int cmd_reset(const struct shell *sh, size_t argc, char **argv)
{
	ARG_UNUSED(argc);
	ARG_UNUSED(argv);

	stats_reset();
	shell_print(sh, "statistics cleared");
	return 0;
}

static int cmd_read(const struct shell *sh, size_t argc, char **argv)
{
	int32_t milli_c;
	char text[16];

	ARG_UNUSED(argc);
	ARG_UNUSED(argv);

	int err = sampler_read(&milli_c);

	if (err != 0) {
		shell_error(sh, "reading the sensor failed: %d", err);
		return err;
	}
	format_milli(text, sizeof(text), milli_c);
	shell_print(sh, "ambient: %s C", text);
	return 0;
}

static int cmd_period(const struct shell *sh, size_t argc, char **argv)
{
	char *end;
	long ms;

	ARG_UNUSED(argc);

	ms = strtol(argv[1], &end, 10);
	if (end == argv[1] || *end != '\0' || ms < REPORTER_MIN_MS || ms > REPORTER_MAX_MS) {
		shell_error(sh, "period must be a whole number of ms from %d to %d", REPORTER_MIN_MS, REPORTER_MAX_MS);
		return -EINVAL;
	}

	(void)reporter_set_period((uint32_t)ms);
	shell_print(sh, "report period %ld ms", ms);
	return 0;
}

SHELL_STATIC_SUBCMD_SET_CREATE(sub_node,
	SHELL_CMD(stats, NULL, "Show the statistics since the last reset.", cmd_stats),
	SHELL_CMD(reset, NULL, "Clear the statistics.", cmd_reset),
	SHELL_CMD(read, NULL, "Read the ambient sensor now.", cmd_read),
	SHELL_CMD_ARG(period, NULL, "Set the report period: period <ms>", cmd_period, 2, 0),
	SHELL_SUBCMD_SET_END);

SHELL_CMD_REGISTER(node, &sub_node, "Sensor node commands", NULL);
```

## src/stats.c
```c
/*
 * The statistics, shared by the processing thread, the report work item and
 * the shell. Every access goes through one mutex, so a reader always gets a
 * consistent copy and never sees samples updated without the sum.
 */
#include <zephyr/kernel.h>
#include <zephyr/sys/printk.h>

#include "stats.h"

static struct stats stats;
K_MUTEX_DEFINE(stats_lock);

void stats_add(int32_t milli_c)
{
	k_mutex_lock(&stats_lock, K_FOREVER);
	if (stats.samples == 0 || milli_c < stats.min_mc) {
		stats.min_mc = milli_c;
	}
	if (stats.samples == 0 || milli_c > stats.max_mc) {
		stats.max_mc = milli_c;
	}
	stats.sum_mc += milli_c;
	stats.samples++;
	k_mutex_unlock(&stats_lock);
}

void stats_count_drop(void)
{
	k_mutex_lock(&stats_lock, K_FOREVER);
	stats.dropped++;
	k_mutex_unlock(&stats_lock);
}

void stats_count_report(void)
{
	k_mutex_lock(&stats_lock, K_FOREVER);
	stats.reports++;
	k_mutex_unlock(&stats_lock);
}

void stats_reset(void)
{
	k_mutex_lock(&stats_lock, K_FOREVER);
	stats = (struct stats){0};
	k_mutex_unlock(&stats_lock);
}

void stats_get(struct stats *out)
{
	k_mutex_lock(&stats_lock, K_FOREVER);
	*out = stats;
	k_mutex_unlock(&stats_lock);
}

void format_milli(char *buf, size_t len, int64_t milli)
{
	const char *sign = milli < 0 ? "-" : "";
	int64_t abs_milli = milli < 0 ? -milli : milli;

	snprintk(buf, len, "%s%d.%03d", sign, (int)(abs_milli / 1000), (int)(abs_milli % 1000));
}
```

## src/stats.h
```c
#ifndef STATS_H
#define STATS_H

#include <stddef.h>
#include <stdint.h>

/* Everything `node stats` and the report show, copied out in one piece. */
struct stats {
	uint32_t samples;
	int32_t min_mc;
	int32_t max_mc;
	int64_t sum_mc;
	uint32_t dropped;
	uint32_t reports;
};

void stats_add(int32_t milli_c);
void stats_count_drop(void);
void stats_count_report(void);
void stats_reset(void);
void stats_get(struct stats *out);

/* "21.250", "-0.500": millidegrees as text with three decimals. */
void format_milli(char *buf, size_t len, int64_t milli);

#endif /* STATS_H */
```
